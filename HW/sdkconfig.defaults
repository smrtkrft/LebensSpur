## HW/sdkconfig.defaults
```kconfig
# ============================================
# LebensSpur - ESP32-C6 SDK Configuration
# ============================================

# --- Target ---
CONFIG_IDF_TARGET="esp32c6"

# --- Flash (Dahili 4MB) ---
CONFIG_ESPTOOLPY_FLASHSIZE_4MB=y
CONFIG_ESPTOOLPY_FLASHSIZE="4MB"

# --- Partition Table ---
CONFIG_PARTITION_TABLE_CUSTOM=y
CONFIG_PARTITION_TABLE_CUSTOM_FILENAME="partitions.csv"

# --- OTA ---
CONFIG_BOOTLOADER_APP_ROLLBACK_ENABLE=y

# --- SPI Flash (Harici 32MB - W25Q256) ---
CONFIG_SPI_FLASH_SUPPORT_BIST=y

# --- WiFi ---
CONFIG_ESP_WIFI_SOFTAP_SUPPORT=y

# --- HTTP Server ---
CONFIG_HTTPD_MAX_REQ_HDR_LEN=1024
CONFIG_HTTPD_MAX_URI_LEN=512

# --- TLS/SSL (SMTP icin) ---
CONFIG_ESP_TLS_USING_MBEDTLS=y

# --- NVS ---
CONFIG_NVS_ENCRYPTION=n

# --- Log Level ---
CONFIG_LOG_DEFAULT_LEVEL_INFO=y
CONFIG_LOG_DEFAULT_LEVEL=3
```

## HW_esp32C6/sdkconfig.defaults
```kconfig
# LebensSpur ESP32-C6 Konfigürasyonu

# Hedef
CONFIG_IDF_TARGET="esp32c6"

# Partition
CONFIG_PARTITION_TABLE_CUSTOM=y
CONFIG_PARTITION_TABLE_CUSTOM_FILENAME="partitions.csv"

# Flash boyutu (dahili)
CONFIG_ESPTOOLPY_FLASHSIZE_4MB=y

# WiFi
CONFIG_ESP_WIFI_SOFTAP_SUPPORT=y
CONFIG_ESP_WIFI_NAN_ENABLE=n

# HTTPS Server
CONFIG_ESP_HTTPS_SERVER_ENABLE=y
CONFIG_HTTPD_MAX_REQ_HDR_LEN=1024
CONFIG_HTTPD_MAX_URI_LEN=512

# LittleFS (external flash - joltwallet/littlefs component)

# mbed TLS (HTTPS için)
CONFIG_MBEDTLS_CERTIFICATE_BUNDLE=y
CONFIG_MBEDTLS_CERTIFICATE_BUNDLE_DEFAULT_FULL=n
CONFIG_MBEDTLS_CERTIFICATE_BUNDLE_DEFAULT_CMN=y
CONFIG_MBEDTLS_SSL_KEEP_PEER_CERTIFICATE=y
CONFIG_MBEDTLS_SSL_MAX_CONTENT_LEN=16384

# SPI Flash (harici W25Q256 için)
CONFIG_SPI_FLASH_SUPPORT_WINBOND_CHIP=y
CONFIG_SPI_FLASH_ENABLE_ENCRYPTED_READ_WRITE=n

# Log seviyesi
CONFIG_LOG_DEFAULT_LEVEL_INFO=y
CONFIG_LOG_MAXIMUM_LEVEL_DEBUG=y

# FreeRTOS
CONFIG_FREERTOS_HZ=1000
CONFIG_FREERTOS_USE_TRACE_FACILITY=y
CONFIG_FREERTOS_USE_STATS_FORMATTING_FUNCTIONS=y

# Heap
CONFIG_HEAP_POISONING_LIGHT=y

# OTA
CONFIG_BOOTLOADER_APP_ROLLBACK_ENABLE=y

# Watchdog
CONFIG_ESP_TASK_WDT_TIMEOUT_S=10
```

## Neue/examples/minimal/sdkconfig.defaults
```kconfig
# Minimal SKAPP-Library device defaults.
CONFIG_IDF_TARGET="esp32c6"
CONFIG_ESPTOOLPY_FLASHSIZE_4MB=y

# USB Serial/JTAG is the default CLI transport in this example.
CONFIG_ESP_CONSOLE_USB_SERIAL_JTAG=y
CONFIG_USB_SERIAL_JTAG_ENABLED=y
CONFIG_ESP_CONSOLE_HISTORY_BUFFER_SIZE=2048

# Bootloader rollback is handy once sk_ota is added; keep on by default.
CONFIG_BOOTLOADER_APP_ROLLBACK_ENABLE=y

# NVS without encryption — fine for dev boards; enable on production.
CONFIG_NVS_ENCRYPTION=n

CONFIG_LOG_DEFAULT_LEVEL_INFO=y
CONFIG_LOG_DEFAULT_LEVEL=3
```

## Neue/sdkconfig.defaults
```kconfig
# LebensSpur — sdkconfig defaults.
CONFIG_IDF_TARGET="esp32c6"
CONFIG_ESPTOOLPY_FLASHSIZE_4MB=y
CONFIG_ESPTOOLPY_FLASHSIZE="4MB"

# USB Serial/JTAG carries the boot log and the CLI (sk_transport_usb).
CONFIG_ESP_CONSOLE_USB_SERIAL_JTAG=y
CONFIG_USB_SERIAL_JTAG_ENABLED=y
CONFIG_ESP_CONSOLE_HISTORY_BUFFER_SIZE=2048

# Bootloader rollback enabled - required by sk_ota.
CONFIG_BOOTLOADER_APP_ROLLBACK_ENABLE=y

# Custom partition table - A/B OTA (1.9 MB each), no userdata partition.
CONFIG_PARTITION_TABLE_CUSTOM=y
CONFIG_PARTITION_TABLE_CUSTOM_FILENAME="partitions.csv"
CONFIG_PARTITION_TABLE_FILENAME="partitions.csv"

# === Bluetooth / NimBLE host stack (sk_transport_ble) =================
CONFIG_BT_ENABLED=y
CONFIG_BT_NIMBLE_ENABLED=y
CONFIG_BT_NIMBLE_NVS_PERSIST=y
# NimBLE host task stack — Curve25519/ECDH altinda 4096 yetmez, BF'de
# de 8192'ye cikarilmis (BF sdkconfig'den miras).
CONFIG_BT_NIMBLE_HOST_TASK_STACK_SIZE=8192
# Peripheral + broadcaster (LS reklam yapar, central olarak baglanmaz).
CONFIG_BT_NIMBLE_ROLE_PERIPHERAL=y
CONFIG_BT_NIMBLE_ROLE_BROADCASTER=y
CONFIG_BT_NIMBLE_GATT_SERVER=y
CONFIG_BT_NIMBLE_SECURITY_ENABLE=y
CONFIG_BT_NIMBLE_SM_SC=y

# ESP-IDF default event loop ("sys_evt") task stack - WiFi STA_CONNECTED
# + GOT_IP fan-out altinda 2304 byte default'unda overflow yapar.
# BF tarafindan 6144'e cikarilmis.
CONFIG_ESP_SYSTEM_EVENT_TASK_STACK_SIZE=6144

# TLS certificate bundle - sk_api + ls_smtp outbound HTTPS dogrulamasi icin.
CONFIG_MBEDTLS_CERTIFICATE_BUNDLE=y
CONFIG_MBEDTLS_CERTIFICATE_BUNDLE_DEFAULT_FULL=y

# NVS without encryption - dev boards icin tamam; production'da acilir.
CONFIG_NVS_ENCRYPTION=n

CONFIG_LOG_DEFAULT_LEVEL_INFO=y
CONFIG_LOG_DEFAULT_LEVEL=3

# Bootloader log level WARN - boot dizisindeki verbose "I (xx) boot:"
# satirlarini sustur.
CONFIG_BOOTLOADER_LOG_LEVEL_WARN=y
CONFIG_BOOTLOADER_LOG_LEVEL=2
```
